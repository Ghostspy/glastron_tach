## main/Kconfig.projbuild
```kconfig
menu "Boat tachometer"
    config TACH_DEMO_MODE
        bool "Simulate RPM and voltage (clearly marked DEMO)"
        default y
        help
            No engine input circuits are configured. Disable this to display
            unavailable readings until a real sensor provider is implemented.

    config TACH_DAY_BRIGHTNESS
        int "Day backlight percent"
        range 10 100
        default 100

    config TACH_NIGHT_BRIGHTNESS
        int "Night backlight percent"
        range 1 100
        default 20
endmenu
```

## sdkconfig.defaults
```kconfig
CONFIG_IDF_TARGET="esp32s3"
CONFIG_ESPTOOLPY_FLASHSIZE_16MB=y
CONFIG_ESP32S3_DEFAULT_CPU_FREQ_240=y
CONFIG_ESP32S3_DATA_CACHE_64KB=y
CONFIG_ESP32S3_DATA_CACHE_LINE_64B=y
CONFIG_SPIRAM=y
CONFIG_SPIRAM_MODE_OCT=y
CONFIG_SPIRAM_SPEED_80M=y
CONFIG_SPIRAM_USE_MALLOC=y
CONFIG_SPIRAM_ALLOW_BSS_SEG_EXTERNAL_MEMORY=y
CONFIG_SPIRAM_FETCH_INSTRUCTIONS=y
CONFIG_SPIRAM_RODATA=y
CONFIG_FREERTOS_HZ=1000
CONFIG_ESP_TASK_WDT_INIT=y
CONFIG_ESP_TASK_WDT_TIMEOUT_S=5
CONFIG_ESP_TASK_WDT_PANIC=y
CONFIG_PARTITION_TABLE_CUSTOM=y
CONFIG_PARTITION_TABLE_CUSTOM_FILENAME="partitions.csv"
CONFIG_TACH_DEMO_MODE=y
CONFIG_LV_CONF_SKIP=n
```
